## base_external/package/aesdchar_driver/Config.in
```kconfig
config BR2_PACKAGE_AESDCHAR_DRIVER
	bool "aesdchar_driver"
	help
	  Supports building and installing the aesdchar driver into the root filesystem.
```

## base_external/package/ldd/Config.in
```kconfig
config BR2_PACKAGE_LDD
	bool "ldd"
	help
	  This facilitates the construction and installation of the misc-modules and scull components within the kernel image's root filesystem.
```
